## dts/bindings/behaviors/zmk,control-gpio.yaml
```yaml
# Copyright (c) 2020 The ZMK Contributors
# SPDX-License-Identifier: MIT

description: GPIO Control behavior

compatible: "zmk,control-gpio"

include: two_param.yaml
```

## dts/bindings/zmk,control-gpio.yaml
```yaml
# Copyright (c) 2024 Andrew Kannan
# SPDX-License-Identifier: MIT

compatible: "zmk,control-gpio"

description: Defining GPIOs to control via keypresses

child-binding:
    description: GPIO output child node
    properties:
       gpios:
          type: phandle-array
          required: true
       starting-state-on:
          required: false
          type: boolean
```
